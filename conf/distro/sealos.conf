## conf/distro/sealos.conf
```bitbake
require conf/distro/poky.conf

DISTRO = "sealos"
DISTRO_NAME = "SealOS - Secure Linux OS"
DISTRO_VERSION = "0.9.5"
DISTRO_FEATURES_append = " systemd"
DISTRO_FEATURES_BACKFILL_CONSIDERED += "sysvinit"
VIRTUAL-RUNTIME_init_manager = "systemd"
VIRTUAL-RUNTIME_initscripts = "systemd-compat-units"

MAINTAINER = "Markus Herpich <markus@opendevices.io>"
```
